## arch/arm64/Kconfig.htc
```kconfig
comment "HTC Debugging Features"
menuconfig HTC_DEBUG
        bool "HTC Debugging Feature Switch"
        default y
        help
          Enable collection of debug features.
          This feature is enabled in defconfig.

comment "HTC features"
menuconfig HTC_FEATURES
        bool "HTC Implement Features"
        default n
        help
          Enable collection of HTC features.
          This feature is enabled in defconfig.

config HTC_DEBUG_RTB
        default n
        depends on HTC_DEBUG && MSM_RTB
        bool "HTC style rtb debug features"
        help
          Say Y here if you want the HTC style rtb debug features

comment "HTC Debug Flag"
menuconfig HTC_ORR
	bool "HTC Debug Flag Features"
        default y
	help
          Enable Debug Flag features.

config LMK_ZYGOTE_PROTECT
	bool "LMK zygote protect"
	default y
	help
	  Say Y here if you want the HTC style for protecting zygote to be killed by LMK with invalid adj values
```

## drivers/htc_debug/stability/Kconfig
```kconfig
#
# HTC_DEBUG stability Kconfig
#

config HTC_DEBUG_KP
        default y
        depends on HTC_DEBUG
        bool "HTC style kernel panic debug features"
        help
          Say Y here if you want the HTC style kernel panic debug features

config HTC_DEBUG_WATCHDOG
        bool "HTC style watchdog debug features"
        depends on HTC_DEBUG && MTK_WD_KICKER
        help
          Say Y here if you want the HTC style watchdog debug features

config HTC_DEBUG_WORKQUEUE
        bool "HTC style workqueue debug features"
        depends on HTC_DEBUG
        default n
        help
          Say Y here if you want the HTC style workqueue debug features

config HTC_EARLY_RTB
       bool "HTC debug feature for enabling RTB before driver is initial"
       default y
       depends on MSM_RTB && HTC_DEBUG && OF && OF_ADDRESS
       help
         This option enables the RTB mechanism before RTB driver is brought up.
         The RTB Log buffer start-address and buffer-size is defined by device-tree.

config HTC_DEBUG_DYING_PROCS
       bool "HTC debug feature for recording dying processes"
       default y
       help
         This option enables the recording of latest 10 killed processes in
         /proc/dying_processes

config HTC_DEBUG_RESTART_TIMER
	bool "add a timer in restart notifier chain"
	default y
	depends on HTC_DEBUG

config HTC_DEBUG_VMALLOC_DUMP
	bool "HTC style vmalloc fail debug features"
	depends on HTC_DEBUG
	default y
	help
	  This option enables the dump for vmalloc info when vmalloc failed.
	  The same information could also be get under /proc/vmallocinfo

config SLUB_LIGHT_WEIGHT_DEBUG_ON
	bool "SLUB light weight debugging on by default"
	depends on SLUB && SLUB_DEBUG && SLUB_DEBUG_ON && !KMEMCHECK
	default n
	help
	  Light weight memory corruption debugging for slub. Only
	  SLAB_DEBUG_FREE was choosen.

config HTC_DEBUG_PAGE_USER_TRACE
	bool "Record call trace of page user in page structure"
	depends on PAGE_POISONING
	default y
	help
	  For debugging purpose, add call trace of user (freer and
	  allocator) to page structure

config HTC_DEBUG_PAGE_ENTRIES_NR
	int
	default 4

config HTC_PROCESS_DEBUG
	bool "process/thread debug support"
	default y
	help
	  This option enables kernel debug log to check if any
	  assigned process receives signal or unexpected exit
```

## drivers/input/fingerprint/Kconfig
```kconfig
#
#Fingerprint
#
config MTK_FINGERPRINT
	tristate "Mediatek Fingerprint"
	default n 
	---help---
	Fingerprint mtk driver enable/disable in the kernel.
	Say Y here if you want to use mediatek fingerprint driver,
	fingerprint driver will support fingerprint function in REE,
	it supports FPC's 102x/104x device.

config FPC_HTC_DISABLE_CHARGING
       tristate "HTC FPC disable charging while capturing image during enroll/verify"
       depends on MTK_FINGERPRINT
       default n
```

## drivers/misc/htc/Kconfig
```kconfig
#
# HTC MISC Driver Kconfig
#
config HTC_REBOOT_REASON_INFORMATION
        default y
        bool "HTC style reboot reason information features"
        help
          Say Y here if you want the HTC style reboot reason information features

config HTC_DEBUG_BOOTLOADER_LOG
        default y
        bool "HTC Bootloader Log Support"
        help
          Say Y here if you want the HTC Bootloader Log Support

config HTC_POWER_MONITOR_LOG
        default n
        bool "HTC Power Monitor Support"
        help
          Say Y here if you want the Power Monitor log

config HTC_MODEM_EXCEPTION_INFO_EXPORT
        bool "HTC modem exception info export"
        default n
        depends on MTK_ECCCI_DRIVER
        help
          export modem exception info for tell htc

config HTC_FEATURES_RIL_PCN0004_HTC_GARBAGE_FILTER
        tristate "HTC_FEATURES_RIL_PCN0004_HTC_GARBAGE_FILTER"
        default n
        depends on MTK_ECCCI_DRIVER
        ---help---
          Garbage Filter of TCP

config HTC_FEATURES_RIL_PCN0005_C2K_POWER_DEBUG
        tristate "HTC_FEATURES_RIL_PCN0005_C2K_POWER_DEBUG"
        default n
        depends on MTK_ECCCI_DRIVER
        ---help---
          Help to debug c2k power

config HTC_FEATURES_RIL_PCN0006_DRDI
        tristate "HTC_FEATURES_RIL_PCN0006_DRDI"
        default n
        depends on MTK_ECCCI_DRIVER
        ---help---
          WSD L1 DRDI feature

config HTC_FEATURES_RIL_PCN0007_LWA
        tristate "HTC_FEATURES_RIL_PCN0007_LWA"
        default n
        depends on MTK_ECCCI_DRIVER
        ---help---
          Support LWA future

config HTC_TYPEC_HEADSET_DETECT
        tristate "HTC_TYPEC_HEADSET_DETECT"
        default n
        ---help---
          USB TypeC audio headset detection

config HTC_FEATURES_RIL_PCN0008_MD_SLEEP_DATA
        tristate "HTC_FEATURES_RIL_PCN0008_MD_SLEEP_DATA"
        default n
        depends on MTK_ECCCI_DRIVER
        ---help---
          Support dump modem sleep data for power debug
```

## drivers/misc/mediatek/flashlight/Kconfig
```kconfig
config MTK_FLASHLIGHT
  bool CONFIG_MTK_FLASHLIGHT
  default n
  help
    CONFIG_MTK_FLASHLIGHT

config CUSTOM_KERNEL_FLASHLIGHT
        string "CUSTOM_KERNEL_FLASHLIGHT"
        help
          Kernel space cameara flashlight driver. You can use this driver
          choose cameara flashlight type.

config HTC_FLASHLIGHT_COMMON
        tristate "Common flashlight API for camera"
        help
          Say Y here to enable the common API for front flashlight utilization

config FLASHLIGHT_TPS61310
        tristate "TI TPS61310 flashlight"
        help
          Say Y here to enable the TI TPS61310 flashlight
config SY7806_FLASHLIGHT
        tristate "Silergy SY7806 flashlight"
        help
          Say Y here to enable the Silergy SY7806 flashlight
```

## drivers/misc/mediatek/lcm/Kconfig
```kconfig
config MTK_LCM
	bool CONFIG_MTK_LCM
	default n
	help
	  LCM driver

config MTK_I2C_LP8557
	bool MTK_I2C_LP8557
	default n
	help
	  config i2c lp8557

config MTK_GPIO_REQUEST
	bool MTK_GPIO_REQUEST
	default n
	help
	  LCM gpio request

config CUSTOM_KERNEL_LCM
	string "CUSTOM_KERNEL_LCM"
	help
	  To choose kernel LCM driver name
	  
config MTK_CPU_PWM
	bool MTK_CPU_PWM
	default n
	help
	  config cpu pwm

config MTK_LCM_DEVICE_TREE_SUPPORT
	bool "MTK_LCM_DEVICE_TREE_SUPPORT"
	help
	  Decide whether to support LCM device tree based configuration.
	  This feature requires the connection between display driver and LCM devices.
	  Please also turn on MTK_LCM_DEVICE_TREE_SUPPORT in ProjectConfig.mk.
```

## drivers/misc/mediatek/power/Kconfig
```kconfig
# Power Related
config MTK_PMIC
	bool "MediaTek PMIC driver"
	default y
	---help---
	  MediaTek PMIC driver

config MTK_BQ25896_SUPPORT
	bool "MTK_BQ25896_SUPPORT"
	select MTK_SWITCH_INPUT_OUTPUT_CURRENT_SUPPORT
	default n
	---help---
	Mediatek TI BQ25896 driver.
	Set y to support this driver.
	Set n and choose other chargers.
	This driver uses I2c bus.

config MTK_BQ25898_DUAL_SUPPORT
	bool "MTK_BQ25898_DUAL_SUPPORT"
	select MTK_SWITCH_INPUT_OUTPUT_CURRENT_SUPPORT
	default n
	---help---
	Mediatek TI BQ25898D driver.
	Set y to support this driver.
	Set n and choose other chargers.
	This driver uses I2c bus.

## HTC_USB_START
config MTK_BQ25896_BOOST_ILIM
	int "Boost mode current limit (0.5A ~ 2.15A)"
	range 0 6
	depends on MTK_BQ25896_SUPPORT
	default "3"
	---help---
	Mediatek TI BQ25896 driver boost mode current limit
	Value	Current(A)
	0	0.5
	1	0.75
	2	1.2
	3	1.4
	4	1.65
	5	1.875
	6	2.15

config MTK_BQ25896_PFM_OTG_ENABLE
	bool "Enable PFM mode in boost mode"
	depends on MTK_BQ25896_SUPPORT
	default n
	---help---
	Mediatek TI BQ25896 driver enable PFM mode in boost mode
	Set y to allow PFM mode.
	Set n to disable PFM mode.
## HTC_USB_END

config MTK_SWITCH_INPUT_OUTPUT_CURRENT_SUPPORT
	bool "MTK_SWITCH_INPUT_OUTPUT_CURRENT_SUPPORT"
	default n
	---help---
	Mediatek switch charger input output current.
	Set y to support.
	Set n to disable.
	switch charger often supports this feature.

config MTK_BIF_SUPPORT
	bool "MTK_BIF_SUPPORT"
	select MTK_DYNAMIC_BAT_CV_SUPPORT
	default n
	---help---
	Mediatek smart battery BIF feature.
	BIF feature provides battery information
	to AP and no need to use AuxADC
	to get battery information.

config MTK_DYNAMIC_BAT_CV_SUPPORT
	bool "MTK_DYNAMIC_BAT_CV_SUPPORT"
	default n
	---help---
	Mediatek dynamic CV support with BIF battery
	BIF feature provides battery information
	to AP and no need to use AuxADC
	to get battery voltage.

config MTK_WIRELESS_CHARGER_SUPPORT
	bool "MTK_WIRELESS_CHARGER_SUPPORT"
	default n
	---help---
	yes : support wireless charger feature, it can show the wireless
	charging animation and charging icon when receive wireless charger
	plug-in. no: not support wireless charger feature, stay with
	legancy feature, which cannot sense the exist of the wireles
	charger.

config MTK_POWER_EXT_DETECT
	bool "MediaTek Power Ext detect"
	default n
	---help---
	EVB/Phone share load configration.
	Require one GPIO to do detection,
	GPIO high mean EVB, otherwise mean phone platform.

config TPS6128x_SUPPORT
	bool "TPS6128x_SUPPORT"
	default n
	---help---
	TPS6128x Low-, Wide- Voltage Battery Front-End DC/DC Converter.
	Set y to support this driver.
	Set n and choose other chargers.
	This driver uses I2c bus.
```

## drivers/misc/mediatek/usb_c/switch/Kconfig
```kconfig
#
# HTC FSA3030UMX switch driver
#

config SWITCH_FSA3030
	bool "Fairchild switch FSA3030UMX support"
	default n
	---help---
		The FSA3030 is a bi-directional, low-power, high-speed,
		3:1, USB2.0, MHL™ and audio switch.
```

## drivers/misc/mediatek/vibrator/Kconfig
```kconfig
config MTK_VIBRATOR
    tristate "MediaTek Vibrator driver"
    default n
	---help---
	Vibrator driver support for MediaTek SOC.
	You can customize the vibrate strength and lowest vibrate time.
	If you want to use MediaTek Vibrator driver, say Y or M here.
	If unsure, say N.

config INPUT_DRV260X_HAPTICS
       tristate "TI DRV260X haptics support"
       depends on INPUT && I2C && GPIOLIB
       select INPUT_FF_MEMLESS
       select REGMAP_I2C
       help
               Say Y to enable support for the TI DRV260X haptics driver.
               To compile this driver as a module, choose M here: the
               module will be called drv260x-haptics.

config VIB_DRV2624
       tristate "TI DRV2624 support"
       depends on INPUT && I2C && GPIOLIB
       select INPUT_FF_MEMLESS
       select REGMAP_I2C
       help
               Say Y to enable support for the TI DRV2624 driver.
               To compile this driver as a module, choose M here: the
               module will be called drv2624.

config VIB_TRIGGERS
    bool "vibrator trigger api"
    default y

config I2C_VIB
    bool "disable readlock when using TI VIB"
        default n
```

## drivers/misc/mediatek/vibrator/drv2624/Kconfig
```kconfig
config VIB_DRV2624
    tristate "TI Drv2624 Vibrator driver"
    default n
	---help---
	Vibrator driver support for TI SOC.
	You can customize the vibrate strength and lowest vibrate time.
	If you want to use TI Vibrator driver, say Y or M here.
	If unsure, say N.
```

## drivers/misc/mediatek/vibrator/drv2625/Kconfig
```kconfig
config VIB_DRV2625
    tristate "TI Drv2625 Vibrator driver"
    default n
	---help---
	Vibrator driver support for TI SOC.
	You can customize the vibrate strength and lowest vibrate time.
	If you want to use TI Vibrator driver, say Y or M here.
	If unsure, say N.
```
